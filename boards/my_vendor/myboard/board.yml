## boards/my_vendor/myboard/board.yml
```yaml
board:
  name: myboard
  full_name: STM32F4 myboard
  vendor: my_vendor
  socs:
    - name: stm32f407xx
```

## boards/st/myboard/board.yml
```yaml
board:
  name: myboard
  full_name: STM32F4 myboard
  vendor: st
  socs:
    - name: stm32f407xx
```
